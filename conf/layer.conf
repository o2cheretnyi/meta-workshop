## conf/layer.conf
```bitbake
# We have a conf and classes directory, add to BBPATH
BBPATH .= ":${LAYERDIR}"

# We have recipes-* directories, add to BBFILES
BBFILES += "${LAYERDIR}/recipes-*/*/*.bb \
            ${LAYERDIR}/recipes-*/*/*.bbappend"

BBFILE_COLLECTIONS += "meta-workshop"
BBFILE_PATTERN_meta-workshop = "^${LAYERDIR}/"
BBFILE_PRIORITY_meta-workshop = "6"

LAYERDEPENDS_meta-workshop = "core"
LAYERSERIES_COMPAT_meta-workshop = "honister"
```
